## Kconfig
```
mainmenu "Heartbeat LED Configuration"

config APP_HEARTBEAT_PERIOD_MS
    int "Heartbeat LED Period (ms)"
    default 500
    range 100 2000
    help
      Sets the blinking period for the heartbeat LED.
	  
source "Kconfig.zephyr"
```

## prj.conf
```kconfig
CONFIG_ESP32_USE_UNSUPPORTED_REVISION=y

CONFIG_SYS_CLOCK_HW_CYCLES_PER_SEC=80000000

CONFIG_GPIO=y
CONFIG_SERIAL=y
CONFIG_LOG=y
CONFIG_CONSOLE=y
CONFIG_UART_CONSOLE=y
```

## app.overlay
```dts
/ {
    /* led on pin 23 that is connectet to a thriac via a optocoupler */
    leds {
        compatible = "gpio-leds";
        led_moc: led_moc {
            gpios = <&gpio0 23 GPIO_ACTIVE_HIGH>;
            label = "MOC Triac Control";
        };
    };

    /* Alias for the led */
    aliases {
        app-led = &led_moc;
    };
};
```

## boards/my_board/my_board_appcpu.dts
```dts
/dts-v1/;

/ {
    model = "My Board from scratch APPCPU";
    compatible = "custom_vendor,my_board";

    chosen {
        zephyr,sram = &sram1;
        zephyr,ipc_shm = &shm0;
        zephyr,ipc = &ipm0;
        zephyr,flash = &flash0;
     	zephyr,code-partition = &slot0_appcpu_partition;

    };
};

&ipm0 {
    status = "okay";
};

&trng0 {
    status = "okay";
};
```

## boards/my_board/my_board_procpu.dts
```dts
/dts-v1/;

/ {
    model = "My Board from scratch PROCPU";
    compatible = "custom_vendor,my_board";

    aliases{
        watchdog0 = &wdt0;
    };

    chosen {
		zephyr,sram = &sram1;
		zephyr,console = &uart0;
		zephyr,shell-uart = &uart0;
		zephyr,flash = &flash0;
		zephyr,code-partition = &slot0_partition;
    };
    
};

&gpio0 {
	status = "okay";
};
```

## src/main.cpp
```c
#include <zephyr/kernel.h>
#include <zephyr/drivers/gpio.h>

// get the GPIO specification for the LED from the device tree
static const struct gpio_dt_spec heart_led = GPIO_DT_SPEC_GET(DT_ALIAS(app_led), gpios);

int main(void)
{
    if (!gpio_is_ready_dt(&heart_led)) {
        return -1;
    }

    gpio_pin_configure_dt(&heart_led, GPIO_OUTPUT_ACTIVE);

    while (1) {
        gpio_pin_toggle_dt(&heart_led);
        
        // Use the configured heartbeat period from Kconfig
        k_msleep(CONFIG_APP_HEARTBEAT_PERIOD_MS);
    }
    return 0;
}
```
