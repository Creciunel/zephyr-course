/dts-v1/;

/ {
    model = "My Board from scratch APPCPU";
    compatible = "custom_vendor,my_board";

    chosen {
        zephyr,sram = &sram1;
        zephyr,ipc_shm = &shm0;
        zephyr,ipc = &ipm0;
        zephyr,flash = &flash0;
     	zephyr,code-partition = &slot0_appcpu_partition;

    };
};

&ipm0 {
    status = "okay";
};

&trng0 {
    status = "okay";
};