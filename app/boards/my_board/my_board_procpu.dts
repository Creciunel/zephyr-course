/dts-v1/;

/ {
    model = "My Board from scratch PROCPU";
    compatible = "custom_vendor,my_board";

    aliases{
        watchdog0 = &wdt0;
    };

    chosen {
		zephyr,sram = &sram1;
		zephyr,console = &uart0;
		zephyr,shell-uart = &uart0;
		zephyr,flash = &flash0;
		zephyr,code-partition = &slot0_partition;
    };
    
};

&gpio0 {
	status = "okay";
};